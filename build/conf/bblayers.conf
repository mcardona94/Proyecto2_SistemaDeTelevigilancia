## build/conf/bblayers.conf
```bitbake
# POKY_BBLAYERS_CONF_VERSION is increased each time build/conf/bblayers.conf
# changes incompatibly

POKY_BBLAYERS_CONF_VERSION = "2"

BBPATH = "${TOPDIR}"
BBFILES ?= ""

BBLAYERS ?= " \
  /home/mcardona/Desktop/Embebidos/poky-warrior/meta \
  /home/mcardona/Desktop/Embebidos/poky-warrior/meta-poky \
  /home/mcardona/Desktop/Embebidos/poky-warrior/meta-yocto-bsp \
  /home/mcardona/Desktop/Embebidos/poky-warrior/meta-openembedded/meta-oe \
  /home/mcardona/Desktop/Embebidos/poky-warrior/meta-openembedded/meta-python \
  /home/mcardona/Desktop/Embebidos/poky-warrior/meta-qt5 \
  /home/mcardona/Desktop/Embebidos/poky-warrior/meta-proyecto1 \
  /home/mcardona/Desktop/Embebidos/poky-warrior/build/workspace \
  /home/mcardona/Desktop/Embebidos/poky-warrior/meta-libimutils \
  "
```

## meta-proyecto1/conf/layer.conf
```bitbake
# We have a conf and classes directory, add to BBPATH
BBPATH .= ":${LAYERDIR}"

# We have recipes-* directories, add to BBFILES
BBFILES += "${LAYERDIR}/recipes-*/*.bb \
	${LAYERDIR}/recipes-*/*/*.bbappend"

BBFILE_COLLECTIONS += "proyecto1"
BBFILE_PATTERN_proyecto1 = "^${LAYERDIR}/"
BBFILE_PRIORITY_proyecto1 = "5"
LAYERVERSION_proyecto1 = "4"
LAYERSERIES_COMPAT_proyecto1 = "warrior"
```
